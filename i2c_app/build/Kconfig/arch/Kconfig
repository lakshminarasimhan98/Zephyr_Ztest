## i2c_app/build/Kconfig/arch/Kconfig
```kconfig
# Load Zephyr Arch Kconfig descriptions.
osource "/home/lakshminarasimhans/zephyrtraining/zephyr/arch/rx/Kconfig"
osource "/home/lakshminarasimhans/zephyrtraining/zephyr/arch/x86/Kconfig"
osource "/home/lakshminarasimhans/zephyrtraining/zephyr/arch/xtensa/Kconfig"
osource "/home/lakshminarasimhans/zephyrtraining/zephyr/arch/sparc/Kconfig"
osource "/home/lakshminarasimhans/zephyrtraining/zephyr/arch/riscv/Kconfig"
osource "/home/lakshminarasimhans/zephyrtraining/zephyr/arch/posix/Kconfig"
osource "/home/lakshminarasimhans/zephyrtraining/zephyr/arch/mips/Kconfig"
osource "/home/lakshminarasimhans/zephyrtraining/zephyr/arch/arm64/Kconfig"
osource "/home/lakshminarasimhans/zephyrtraining/zephyr/arch/arm/Kconfig"
osource "/home/lakshminarasimhans/zephyrtraining/zephyr/arch/arc/Kconfig"
```

## i2c_app/build/Kconfig/boards/Kconfig
```kconfig
# Load Zephyr board Kconfig descriptions.
osource "/home/lakshminarasimhans/zephyrtraining/zephyr/boards/st/nucleo_h745zi_q/Kconfig"
```

## i2c_app/build/Kconfig/boards/Kconfig.defconfig
```kconfig
# Load Zephyr board defconfig descriptions.
osource "/home/lakshminarasimhans/zephyrtraining/zephyr/boards/st/nucleo_h745zi_q/Kconfig.defconfig"
```

## i2c_app/build/Kconfig/soc/Kconfig
```kconfig
# Load Zephyr SoC Kconfig descriptions.
osource "/home/lakshminarasimhans/zephyrtraining/zephyr/soc/xlnx/zynqmp/Kconfig"
osource "/home/lakshminarasimhans/zephyrtraining/zephyr/soc/xlnx/zynq7000/Kconfig"
osource "/home/lakshminarasimhans/zephyrtraining/zephyr/soc/xlnx/versalnet/Kconfig"
osource "/home/lakshminarasimhans/zephyrtraining/zephyr/soc/xlnx/versal2/Kconfig"
osource "/home/lakshminarasimhans/zephyrtraining/zephyr/soc/xen/Kconfig"
osource "/home/lakshminarasimhans/zephyrtraining/zephyr/soc/wch/ch32v/Kconfig"
osource "/home/lakshminarasimhans/zephyrtraining/zephyr/soc/ti/simplelink/Kconfig"
osource "/home/lakshminarasimhans/zephyrtraining/zephyr/soc/ti/mspm0/Kconfig"
osource "/home/lakshminarasimhans/zephyrtraining/zephyr/soc/ti/lm3s6965/Kconfig"
osource "/home/lakshminarasimhans/zephyrtraining/zephyr/soc/ti/k3/Kconfig"
osource "/home/lakshminarasimhans/zephyrtraining/zephyr/soc/telink/tlsr/Kconfig"
osource "/home/lakshminarasimhans/zephyrtraining/zephyr/soc/starfive/jh71xx/Kconfig"
osource "/home/lakshminarasimhans/zephyrtraining/zephyr/soc/st/stm32/Kconfig"
osource "/home/lakshminarasimhans/zephyrtraining/zephyr/soc/snps/qemu_arc/Kconfig"
osource "/home/lakshminarasimhans/zephyrtraining/zephyr/soc/snps/nsim/arc_v/Kconfig"
osource "/home/lakshminarasimhans/zephyrtraining/zephyr/soc/snps/nsim/arc_classic/Kconfig"
osource "/home/lakshminarasimhans/zephyrtraining/zephyr/soc/snps/hsdk4xd/Kconfig"
osource "/home/lakshminarasimhans/zephyrtraining/zephyr/soc/snps/hsdk/Kconfig"
osource "/home/lakshminarasimhans/zephyrtraining/zephyr/soc/snps/emsk/Kconfig"
osource "/home/lakshminarasimhans/zephyrtraining/zephyr/soc/snps/emsdp/Kconfig"
osource "/home/lakshminarasimhans/zephyrtraining/zephyr/soc/snps/arc_iot/Kconfig"
osource "/home/lakshminarasimhans/zephyrtraining/zephyr/soc/silabs/Kconfig"
osource "/home/lakshminarasimhans/zephyrtraining/zephyr/soc/sifive/sifive_freedom/Kconfig"
osource "/home/lakshminarasimhans/zephyrtraining/zephyr/soc/sensry/Kconfig"
osource "/home/lakshminarasimhans/zephyrtraining/zephyr/soc/rockchip/Kconfig"
osource "/home/lakshminarasimhans/zephyrtraining/zephyr/soc/renode/riscv_virtual/Kconfig"
osource "/home/lakshminarasimhans/zephyrtraining/zephyr/soc/renode/cortex_r8_virtual/Kconfig"
osource "/home/lakshminarasimhans/zephyrtraining/zephyr/soc/renesas/smartbond/Kconfig"
osource "/home/lakshminarasimhans/zephyrtraining/zephyr/soc/renesas/rz/Kconfig"
osource "/home/lakshminarasimhans/zephyrtraining/zephyr/soc/renesas/rx/Kconfig"
osource "/home/lakshminarasimhans/zephyrtraining/zephyr/soc/renesas/rcar/Kconfig"
osource "/home/lakshminarasimhans/zephyrtraining/zephyr/soc/renesas/ra/Kconfig"
osource "/home/lakshminarasimhans/zephyrtraining/zephyr/soc/realtek/ec/Kconfig"
osource "/home/lakshminarasimhans/zephyrtraining/zephyr/soc/raspberrypi/rpi_pico/Kconfig"
osource "/home/lakshminarasimhans/zephyrtraining/zephyr/soc/quicklogic/eos_s3/Kconfig"
osource "/home/lakshminarasimhans/zephyrtraining/zephyr/soc/qemu/virt_riscv/Kconfig"
osource "/home/lakshminarasimhans/zephyrtraining/zephyr/soc/qemu/malta/Kconfig"
osource "/home/lakshminarasimhans/zephyrtraining/zephyr/soc/openisa/rv32m1/Kconfig"
osource "/home/lakshminarasimhans/zephyrtraining/zephyr/soc/openhwgroup/cva6/Kconfig"
osource "/home/lakshminarasimhans/zephyrtraining/zephyr/soc/oct/osd32mp15x/Kconfig"
osource "/home/lakshminarasimhans/zephyrtraining/zephyr/soc/nxp/s32/Kconfig"
osource "/home/lakshminarasimhans/zephyrtraining/zephyr/soc/nxp/rw/Kconfig"
osource "/home/lakshminarasimhans/zephyrtraining/zephyr/soc/nxp/mcx/Kconfig"
osource "/home/lakshminarasimhans/zephyrtraining/zephyr/soc/nxp/lpc/Kconfig"
osource "/home/lakshminarasimhans/zephyrtraining/zephyr/soc/nxp/layerscape/Kconfig"
osource "/home/lakshminarasimhans/zephyrtraining/zephyr/soc/nxp/kinetis/Kconfig"
osource "/home/lakshminarasimhans/zephyrtraining/zephyr/soc/nxp/imxrt/Kconfig"
osource "/home/lakshminarasimhans/zephyrtraining/zephyr/soc/nxp/imx/Kconfig"
osource "/home/lakshminarasimhans/zephyrtraining/zephyr/soc/nuvoton/numicro/Kconfig"
osource "/home/lakshminarasimhans/zephyrtraining/zephyr/soc/nuvoton/numaker/Kconfig"
osource "/home/lakshminarasimhans/zephyrtraining/zephyr/soc/nuvoton/npcx/Kconfig"
osource "/home/lakshminarasimhans/zephyrtraining/zephyr/soc/nuvoton/npcm/Kconfig"
osource "/home/lakshminarasimhans/zephyrtraining/zephyr/soc/nordic/Kconfig"
osource "/home/lakshminarasimhans/zephyrtraining/zephyr/soc/neorv32/Kconfig"
osource "/home/lakshminarasimhans/zephyrtraining/zephyr/soc/native/inf_clock/Kconfig"
osource "/home/lakshminarasimhans/zephyrtraining/zephyr/soc/microchip/sam/Kconfig"
osource "/home/lakshminarasimhans/zephyrtraining/zephyr/soc/microchip/miv/Kconfig"
osource "/home/lakshminarasimhans/zephyrtraining/zephyr/soc/microchip/mec/Kconfig"
osource "/home/lakshminarasimhans/zephyrtraining/zephyr/soc/mediatek/mt8xxx/Kconfig"
osource "/home/lakshminarasimhans/zephyrtraining/zephyr/soc/lowrisc/opentitan/Kconfig"
osource "/home/lakshminarasimhans/zephyrtraining/zephyr/soc/litex/litex_vexriscv/Kconfig"
osource "/home/lakshminarasimhans/zephyrtraining/zephyr/soc/ite/ec/Kconfig"
osource "/home/lakshminarasimhans/zephyrtraining/zephyr/soc/intel/raptor_lake/Kconfig"
osource "/home/lakshminarasimhans/zephyrtraining/zephyr/soc/intel/lakemont/Kconfig"
osource "/home/lakshminarasimhans/zephyrtraining/zephyr/soc/intel/intel_socfpga_std/Kconfig"
osource "/home/lakshminarasimhans/zephyrtraining/zephyr/soc/intel/intel_socfpga/Kconfig"
osource "/home/lakshminarasimhans/zephyrtraining/zephyr/soc/intel/intel_niosv/Kconfig"
osource "/home/lakshminarasimhans/zephyrtraining/zephyr/soc/intel/intel_ish/Kconfig"
osource "/home/lakshminarasimhans/zephyrtraining/zephyr/soc/intel/intel_adsp/Kconfig"
osource "/home/lakshminarasimhans/zephyrtraining/zephyr/soc/intel/elkhart_lake/Kconfig"
osource "/home/lakshminarasimhans/zephyrtraining/zephyr/soc/intel/atom/Kconfig"
osource "/home/lakshminarasimhans/zephyrtraining/zephyr/soc/intel/apollo_lake/Kconfig"
osource "/home/lakshminarasimhans/zephyrtraining/zephyr/soc/intel/alder_lake/Kconfig"
osource "/home/lakshminarasimhans/zephyrtraining/zephyr/soc/infineon/cat3/Kconfig"
osource "/home/lakshminarasimhans/zephyrtraining/zephyr/soc/infineon/cat1c/Kconfig"
osource "/home/lakshminarasimhans/zephyrtraining/zephyr/soc/infineon/cat1b/Kconfig"
osource "/home/lakshminarasimhans/zephyrtraining/zephyr/soc/infineon/cat1a/Kconfig"
osource "/home/lakshminarasimhans/zephyrtraining/zephyr/soc/gd/gd32/Kconfig"
osource "/home/lakshminarasimhans/zephyrtraining/zephyr/soc/gaisler/leon3/Kconfig"
osource "/home/lakshminarasimhans/zephyrtraining/zephyr/soc/gaisler/gr716a/Kconfig"
osource "/home/lakshminarasimhans/zephyrtraining/zephyr/soc/espressif/Kconfig"
osource "/home/lakshminarasimhans/zephyrtraining/zephyr/soc/ene/kb1200/Kconfig"
osource "/home/lakshminarasimhans/zephyrtraining/zephyr/soc/efinix/sapphire/Kconfig"
osource "/home/lakshminarasimhans/zephyrtraining/zephyr/soc/cdns/xtensa_sample_controller/Kconfig"
osource "/home/lakshminarasimhans/zephyrtraining/zephyr/soc/cdns/sample_controller32/Kconfig"
osource "/home/lakshminarasimhans/zephyrtraining/zephyr/soc/cdns/dc233c/Kconfig"
osource "/home/lakshminarasimhans/zephyrtraining/zephyr/soc/brcm/bcmvk/Kconfig"
osource "/home/lakshminarasimhans/zephyrtraining/zephyr/soc/brcm/bcm2712/Kconfig"
osource "/home/lakshminarasimhans/zephyrtraining/zephyr/soc/brcm/bcm2711/Kconfig"
osource "/home/lakshminarasimhans/zephyrtraining/zephyr/soc/bflb/Kconfig"
osource "/home/lakshminarasimhans/zephyrtraining/zephyr/soc/atmel/sam0/Kconfig"
osource "/home/lakshminarasimhans/zephyrtraining/zephyr/soc/atmel/sam/Kconfig"
osource "/home/lakshminarasimhans/zephyrtraining/zephyr/soc/aspeed/Kconfig"
osource "/home/lakshminarasimhans/zephyrtraining/zephyr/soc/arm/Kconfig"
osource "/home/lakshminarasimhans/zephyrtraining/zephyr/soc/arm/beetle/Kconfig"
osource "/home/lakshminarasimhans/zephyrtraining/zephyr/soc/antmicro/myra/Kconfig"
osource "/home/lakshminarasimhans/zephyrtraining/zephyr/soc/andestech/Kconfig"
osource "/home/lakshminarasimhans/zephyrtraining/zephyr/soc/amd/acp_6_0/Kconfig"
osource "/home/lakshminarasimhans/zephyrtraining/zephyr/soc/ambiq/Kconfig"
osource "/home/lakshminarasimhans/zephyrtraining/zephyr/soc/aesc/Kconfig"
osource "/home/lakshminarasimhans/zephyrtraining/zephyr/soc/adi/max32/Kconfig"
```
